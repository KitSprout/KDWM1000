/*====================================================================================================*/
/*====================================================================================================*/
#include "drivers\stm32f4_system.h"
#include "modules\module_serial.h"

#include "kdwm1000.h"
/*====================================================================================================*/
/*====================================================================================================*/
void UART_RecvEven( void )
{
  uint8_t recvData = Serial_RecvByte();
  if(recvData == 0x0D)
    Serial_SendStr("\r\n");
  else
    Serial_SendByte(recvData);
}

void KDWM_Init( void )
{
  SystemInit();
  HAL_InitTick();

  KDWM_GPIO_Config();
  KDWM_UART_Config(UART_RecvEven);
}
/*====================================================================================================*/
/*====================================================================================================*/
void KDWM_Loop( void )
{
  while(1) {
    if(KEY_Read()) {
      printf("\f");
    }
  }
}
/*====================================================================================================*/
/*====================================================================================================*/
